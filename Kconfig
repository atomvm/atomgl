## Kconfig
```kconfig
# Copyright 2020-2022 Davide Bettio <davide@uninstall.it>
#
# SPDX-License-Identifier: Apache-2.0

menu "AtomVM Display Driver"

config AVM_DISPLAY_INIT_SPI_BUS
    bool "Initialize SPI bus"
    default y

config AVM_DISPLAY_MISO_IO_NUM
    int "SPI MISO IO Num"
    default 19

config AVM_DISPLAY_MOSI_IO_NUM
    int "SPI MOSI IO Num"
    default 23

config AVM_DISPLAY_SCLK_IO_NUM
    int "SPI CLK IO Num"
    default 18

config AVM_DISPLAY_SPI_CLOCK_HZ
    int "SPI Clock Hz"
    default 27000000

config AVM_ILI934X_BACKLIGHT_IO_NUM
    int "Backlight IO Num"
    default 32

config AVM_DISPLAY_DC_IO_NUM
    int "Display DC IO Num"
    default 27

config AVM_DISPLAY_RESET_IO_NUM
    int "Display Reset IO Num"
    default 33

config AVM_DISPLAY_SD_ENABLE
    bool "SD Enable"
    default y

config AVM_DISPLAY_SD_CS_IO_NUM
    int "SD CS IO Num"
    default 4

config AVM_ILI934X_ENABLE_ILI9342C
    bool "Enable ILI9342c support"
    default y

config AVM_ILI934X_ENABLE_TFT_INVON
    bool "Enable TFT_INVON"
    default y

endmenu
```
